## P2_RS485_Controllable_Breaker/boards/pai_gdc/Kconfig.pai_gdc
```kconfig
# Copyright 2021 The Chromium OS Authors
# SPDX-License-Identifier: Apache-2.0

config BOARD_PAI_GDC
    bool "PAI Generator Dispatch Controller"
    help
      This board is the PAI Generator Dispatch Controller (GDC) board.
	select SOC_STM32G081XX
```

## P2_RS485_Controllable_Breaker/boards/pai_gdc/board.yml
```yaml
board:
  name: pai_gdc
  full_name: PAI Generator Dispatch Controller
  vendor: st
  socs:
    - name: stm32g081xx
```
